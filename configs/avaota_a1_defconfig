## configs/avaota_a1_defconfig
```kconfig
CONFIG_ARM=y
CONFIG_ARCH_SUNXI=y
CONFIG_DEFAULT_DEVICE_TREE="sun50i-h616-orangepi-zero2"
CONFIG_SPL=y
CONFIG_DRAM_SUN50I_H616_DX_ODT=0x07070707
CONFIG_DRAM_SUN50I_H616_DX_DRI=0x0d0d0d0d
CONFIG_DRAM_SUN50I_H616_CA_DRI=0x0e0e
CONFIG_DRAM_SUN50I_H616_ODT_EN=0x84848484
CONFIG_DRAM_SUN50I_H616_TPR0=0x80808080
CONFIG_DRAM_SUN50I_H616_TPR1=0x06060606
CONFIG_DRAM_SUN50I_H616_TPR6=0x38000000
CONFIG_DRAM_SUN50I_H616_TPR10=0x802f3333
CONFIG_DRAM_SUN50I_H616_TPR11=0xc7c5c4c2
CONFIG_DRAM_SUN50I_H616_TPR12=0x3533302f
CONFIG_DRAM_CLK=1200
CONFIG_MACH_SUN55I_T527=y
CONFIG_SUNXI_DRAM_T527_LPDDR4=y
CONFIG_R_I2C_ENABLE=y
# CONFIG_SYS_MALLOC_CLEAR_ON_INIT is not set
CONFIG_SPL_I2C=y
CONFIG_SPL_SYS_I2C_LEGACY=y
CONFIG_SYS_I2C_MVTWSI=y
CONFIG_SYS_I2C_SLAVE=0x7f
CONFIG_SYS_I2C_SPEED=400000
CONFIG_AXP717C_POWER=y
CONFIG_AXP_DCDC2_VOLT=920
CONFIG_AXP_DCDC3_VOLT=1160
```

## configs/h728_x96qproplus_defconfig
```kconfig
CONFIG_OF_UPSTREAM=y
CONFIG_ARM=y
CONFIG_ARCH_SUNXI=y
CONFIG_DEFAULT_DEVICE_TREE="allwinner/sun55i-h728-x96qpro-plus"
CONFIG_SPL=y
CONFIG_DRAM_SUN50I_H616_DX_ODT=0x07070707
CONFIG_DRAM_SUN50I_H616_DX_DRI=0x0c0c0c0c
CONFIG_DRAM_SUN50I_H616_CA_DRI=0x0e0e
CONFIG_DRAM_SUN50I_H616_ODT_EN=0x90909090
CONFIG_DRAM_SUN50I_H616_TPR0=0x80808080
CONFIG_DRAM_SUN50I_H616_TPR6=0x3380807e
CONFIG_DRAM_SUN50I_H616_TPR10=0x882f7788
CONFIG_DRAM_SUN50I_H616_TPR11=0x8f919190
CONFIG_DRAM_SUN50I_H616_TPR12=0x22222723
CONFIG_DRAM_CLK=792
CONFIG_MACH_SUN55I_T527=y
CONFIG_SUNXI_DRAM_T527_DDR3=y
CONFIG_R_I2C_ENABLE=y
CONFIG_SPL_I2C=y
CONFIG_SPL_SYS_I2C_LEGACY=y
CONFIG_SYS_I2C_MVTWSI=y
CONFIG_SYS_I2C_SLAVE=0x7f
CONFIG_SYS_I2C_SPEED=400000
CONFIG_REGULATOR_AXP=y
CONFIG_AXP717_POWER=y
CONFIG_AXP_DCDC1_VOLT=940
CONFIG_AXP_DCDC3_VOLT=1500
```
